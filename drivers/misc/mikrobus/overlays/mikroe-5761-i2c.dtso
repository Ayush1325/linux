// SPDX-License-Identifier: GPL-2.0-or-later OR MIT
/**
 * MikroBUS - Weather Click I2C
 *
 * https://www.mikroe.com/weather-click
 *
 * Copyright (C) 2024 Ayush Singh <ayush@beagleboard.org>
 */

/dts-v1/;
/plugin/;

&MIKROBUS_CONNECTOR {
	status = "okay";
};

&MIKROBUS_SCL_I2C {
	status = "okay";
	pinctrl-names = "default";
	pinctrl-0 = <&MIKROBUS_SDA_MUX_I2C_SDA>;
	#address-cells = <1>;
	#size-cells = <0>;

	bme280@76 {
		compatible = "bosch,bme280";
		reg = <0x76>;
	};
};
