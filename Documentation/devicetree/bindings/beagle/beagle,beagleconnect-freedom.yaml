## Documentation/devicetree/bindings/beagle/beagle,beagleconnect-freedom.yaml
```yaml
# SPDX-License-Identifier: GPL-2.0-only OR BSD-2-Clause
%YAML 1.2
---
$id: http://devicetree.org/schemas/beagle/beagle,beagleconnect-freedom.yaml#
$schema: http://devicetree.org/meta-schemas/core.yaml#

title: BeagleBoard.org BeagleConnect Freedom

description:
  The BeagleBoard.org BeagleConnect Freedom board connected over USB, UART, SPI or I2C.

maintainers:
  - Ayush Singh <ayush@beagleboard.org>

properties:
  compatible:
    const: beagle,beagleconnect-freedom

  reg:
    maxItems: 1

  vbat-supply: true

required:
  - compatible

allOf:
  - if:
      required:
        - reg
    then:
      $ref: /schemas/spi/spi-peripheral-props.yaml#
    else:
      $ref: /schemas/serial/serial-peripheral-props.yaml#

      properties:
        current-speed:
          default: 115200

unevaluatedProperties: false

examples:
  - |
    serial {
      mcu {
        compatible = "beagle,beagleconnect-freedom";
        vbat-supply = <&vbat>;
      };
    };

  - |
    spi {
      #address-cells = <1>;
      #size-cells = <0>;

      mcu@0 {
        compatible = "beagle,beagleconnect-freedom";
        reg = <0>;
        spi-max-frequency = <1000000>;
        vbat-supply = <&vbat>;
      };
    };
```

## drivers/misc/pocketbeagle_connector/Kconfig
```kconfig
menuconfig POCKETBEAGLE_CONNECTOR
	tristate "Module for instantiating devices on PocketBeagle Connector"
	help
	  This option enables the PocketBeagle connector driver.

	  Say Y here to enable support for this driver.

	  To compile this code as a module, chose M here: the module
	  will be called pocketbeagle_connector.ko
```
